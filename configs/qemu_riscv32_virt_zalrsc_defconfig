## configs/qemu_riscv32_virt_zalrsc_defconfig
```kconfig
# Architecture
BR2_riscv=y
BR2_riscv_custom=y
BR2_RISCV_ISA_RVM=y
BR2_RISCV_ISA_EXTRA="zalrsc"
BR2_RISCV_32=y

# System
BR2_GLOBAL_PATCH_DIR="$(BR2_EXTERNAL)/board/qemu/riscv32_virt_zalrsc/patches"
BR2_SYSTEM_DHCP="eth0"
BR2_PTHREADS_NONE=y
BR2_OPTIMIZE_S=y

#toolchain
BR2_TOOLCHAIN_BUILDROOT_MUSL=y
BR2_BINUTILS_VERSION_2_46_X=y
BR2_GCC_VERSION_15_X=y

# Filesystem
BR2_TARGET_ROOTFS_EXT2=y

# Bootloader
BR2_TARGET_OPENSBI=y
BR2_TARGET_OPENSBI_CUSTOM_TARBALL=y
# Needs https://github.com/riscv-software-src/opensbi/commit/b5348006e98077076a0b1a690c3a9f63c7151a4b
BR2_TARGET_OPENSBI_CUSTOM_TARBALL_LOCATION="https://github.com/riscv-software-src/opensbi/archive/refs/heads/master.tar.gz"
BR2_TARGET_OPENSBI_PLAT="generic"
BR2_TARGET_OPENSBI_ADDITIONAL_VARIABLES="PLATFORM_RISCV_ISA=rv32imc_zicsr_zifencei_zalrsc"

# Image
BR2_ROOTFS_POST_IMAGE_SCRIPT="board/qemu/post-image.sh"
BR2_ROOTFS_POST_SCRIPT_ARGS="$(BR2_DEFCONFIG)"

# Linux headers same as kernel
BR2_PACKAGE_HOST_LINUX_HEADERS_CUSTOM_6_18=y

# Kernel
BR2_LINUX_KERNEL=y
BR2_LINUX_KERNEL_CUSTOM_VERSION=y
BR2_LINUX_KERNEL_CUSTOM_VERSION_VALUE="6.18.7"
BR2_LINUX_KERNEL_DEFCONFIG="rv32"
BR2_LINUX_KERNEL_CONFIG_FRAGMENT_FILES="$(BR2_EXTERNAL)/board/qemu/riscv32_virt_zalrsc/linux-no-zaamo.config"
BR2_LINUX_KERNEL_IMAGE=y

# Host tools
BR2_PACKAGE_HOST_QEMU=y
BR2_PACKAGE_HOST_QEMU_SYSTEM_MODE=y
```

## configs/qemu_riscv64_virt_zalrsc_defconfig
```kconfig
# Architecture
BR2_riscv=y
BR2_riscv_custom=y
BR2_RISCV_ISA_RVM=y
BR2_RISCV_ISA_EXTRA="zalrsc"

# System
BR2_GLOBAL_PATCH_DIR="$(BR2_EXTERNAL)/board/qemu/riscv32_virt_zalrsc/patches"
BR2_SYSTEM_DHCP="eth0"
BR2_PTHREADS_NONE=y
BR2_OPTIMIZE_S=y

#toolchain
BR2_TOOLCHAIN_BUILDROOT_MUSL=y
BR2_BINUTILS_VERSION_2_46_X=y
BR2_GCC_VERSION_15_X=y

# Filesystem
BR2_TARGET_ROOTFS_EXT2=y

# Bootloader
BR2_TARGET_OPENSBI=y
BR2_TARGET_OPENSBI_CUSTOM_VERSION=y
BR2_TARGET_OPENSBI_CUSTOM_VERSION_VALUE="1.8.1"
BR2_TARGET_OPENSBI_PLAT="generic"
BR2_TARGET_OPENSBI_ADDITIONAL_VARIABLES="PLATFORM_RISCV_ISA=rv64imc_zicsr_zifencei_zalrsc"

# Image
BR2_ROOTFS_POST_IMAGE_SCRIPT="board/qemu/post-image.sh"
BR2_ROOTFS_POST_SCRIPT_ARGS="$(BR2_DEFCONFIG)"

# Linux headers same as kernel
BR2_PACKAGE_HOST_LINUX_HEADERS_CUSTOM_6_18=y

# Kernel
BR2_LINUX_KERNEL=y
BR2_LINUX_KERNEL_CUSTOM_VERSION=y
BR2_LINUX_KERNEL_CUSTOM_VERSION_VALUE="6.18.7"
BR2_LINUX_KERNEL_USE_ARCH_DEFAULT_CONFIG=y
BR2_LINUX_KERNEL_CONFIG_FRAGMENT_FILES="$(BR2_EXTERNAL)/board/qemu/riscv32_virt_zalrsc/linux-no-zaamo.config"
BR2_LINUX_KERNEL_IMAGE=y

# Host tools
BR2_PACKAGE_HOST_QEMU=y
BR2_PACKAGE_HOST_QEMU_SYSTEM_MODE=y
```
